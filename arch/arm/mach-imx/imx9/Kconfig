## arch/arm/mach-imx/imx9/Kconfig
```kconfig
if ARCH_IMX9

config AHAB_BOOT
    bool "Support i.MX9 AHAB features"
    help
    This option enables the support for AHAB secure boot.

config IMX9
	bool
	select HAS_CAAM
	select ROM_UNIFIED_SECTIONS

config IMX93
	bool
	select IMX9
	select ARMV8_SPL_EXCEPTION_VECTORS

config IMX95
	bool
	select IMX9
	select ARMV8_SPL_EXCEPTION_VECTORS
	select SCMI_FIRMWARE
	select DM_MAILBOX

config SYS_SOC
	default "imx9"

choice
	prompt  "NXP i.MX9 board select"
	optional

config TARGET_IMX93_14X14_EVK
	bool "imx93_14x14_evk"
	select IMX93

config TARGET_IMX93_11X11_EVK
	bool "imx93_11x11_evk"
	select OF_BOARD_FIXUP
	select IMX93

config TARGET_MAAXBOARD_OSM93
	bool "maaxboard-osm93"
	select OF_BOARD_FIXUP
	select IMX93

config TARGET_IMX93_9X9_QSB
	bool "imx93_9x9_qsb"
	select IMX93
	select IMX9_LPDDR4X

config TARGET_IMX91P_11X11_EVK
	bool "imx91p_11x11_evk"
	select IMX93

config TARGET_IMX91P_9X9_QSB
	bool "imx91p_9x9_qsb"
	select IMX93
	select IMX9_LPDDR4X

config TARGET_IMX95_19X19_EVK
	bool "imx95_19x19_evk"
	select IMX95

config TARGET_TITAN_IMX95_19X19
	bool "imx95_titan_evk"
	select IMX95

endchoice

if TARGET_MAAXBOARD_OSM93 || TARGET_IMX93_11X11_EVK || TARGET_IMX93_14X14_EVK || TARGET_IMX91P_11X11_EVK
choice
	prompt "Select DDR Type"
	default IMX93_EVK_LPDDR4X if TARGET_MAAXBOARD_OSM93 || TARGET_IMX93_11X11_EVK || TARGET_IMX93_14X14_EVK
	default IMX93_EVK_LPDDR4 if TARGET_IMX91P_11X11_EVK

config IMX93_EVK_LPDDR4X
	bool "Using LPDDR4X Timing and PMIC voltage"
	select IMX9_LPDDR4X
	help
	  Select the LPDDR4X timing and 0.6V VDDQ

config IMX93_EVK_LPDDR4
	bool "Using LPDDR4 Timing and PMIC voltage"
	select IMX9_LPDDR4X
	help
	  Select the LPDDR4 timing and 1.1V VDDQ

endchoice
endif

source "board/freescale/imx93_evk/Kconfig"
source "board/avnet/maaxboard_osm93/Kconfig"
source "board/freescale/imx93_qsb/Kconfig"
source "board/freescale/imx95_evk/Kconfig"
source "board/toradex/titan-imx95/Kconfig"


endif
```

## board/avnet/maaxboard_osm93/Kconfig
```kconfig
if TARGET_MAAXBOARD_OSM93

config SYS_BOARD
	default "maaxboard_osm93"

config SYS_VENDOR
	default "avnet"

config SYS_CONFIG_NAME
	default "maaxboard_osm93"

config CMD_BOARDINFO
    bool "Enable BOARDINFO command in U-Boot"
    default y
    help
      Whether to enable the addition of the BOARDINFO command in U-Boot.

endif
```

## board/freescale/imx93_evk/Kconfig
```kconfig
if TARGET_IMX93_11X11_EVK || TARGET_IMX93_14X14_EVK || TARGET_IMX91P_11X11_EVK

config SYS_BOARD
	default "imx93_evk"

config SYS_VENDOR
	default "freescale"

config SYS_CONFIG_NAME
	default "imx93_evk"

endif
```
